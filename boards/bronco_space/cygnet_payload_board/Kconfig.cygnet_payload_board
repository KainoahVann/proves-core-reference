## boards/bronco_space/cygnet_payload_board/Kconfig.cygnet_payload_board
```kconfig
config BOARD_CYGNET_PAYLOAD_BOARD
	bool "Cygnet payload board"
	default y

rsource "../../../boards/bronco_space/cygnet_payload_board/Kconfig.defconfig"
```

## boards/bronco_space/cygnet_payload_board/board.yml
```yaml
board:
  name: cygnet_payload_board
  full_name: Cygnet Payload Board
  vendor: Bronco Space
  socs:
  - name: rp2350a
```
